## conf/distro/poky-core.conf
```bitbake
require conf/distro/poky.conf
# distro name
DISTRO = "poky-core"
DISTRO_NAME = "poky core distribution"
DISTRO_VERSION = "1.0"
DISTRO_CODENAME = "core"
#DISTRO_FEATURES_append = " alsa usbhost usbgadget keyboard bluetooth"

# Comment out any of the lines below to disable them in the build
# DISTRO_FEATURES options:
# alsa bluetooth ext2 pcmcia usbgadget usbhost wifi nfs zeroconf pci
DISTRO_FEATURES = " \
    largefile zeroconf virtualization \
    ipv6 \
    usbhost \
    wifi \
    systemd \
"

DISTRO_FEATURES_BACKFILL_CONSIDERED = "sysvinit"
VIRTUAL-RUNTIME_init_manager = "systemd"
VIRTUAL-RUNTIME_initscripts = ""

POKY_DEFAULT_EXTRA_RDEPENDS = "packagegroup-core-boot"
POKY_DEFAULT_EXTRA_RRECOMMENDS = "kernel-module-af-packet"

# INIT_MANAGER ?= "mdev-busybox"
TCLIBC = "glibc"

# Disable wide char support for ncurses as we don't include it in
# in the LIBC features below.
# Leave native enable to avoid build failures
ENABLE_WIDEC = "false"
ENABLE_WIDEC_class-native = "true"

# Drop native language support. This removes the
# eglibc->bash->gettext->libc-posix-clang-wchar dependency.
USE_NLS="no"

SDK_VENDOR = "-coredistsdk"
SDK_VERSION := "${@'${DISTRO_VERSION}'.replace('snapshot-${DATE}','snapshot')}"
MAINTAINER = "shoe"
INHERIT += "buildhistory"
BUILDHISTORY_COMMIT = "1"
```

## meta-rpi-podman/conf/layer.conf
```bitbake
# We have a conf and classes directory, add to BBPATH
BBPATH .= ":${LAYERDIR}"

# We have recipes-* directories, add to BBFILES
BBFILES += " \
	${LAYERDIR}/recipes-*/*/*.bb \
	${LAYERDIR}/recipes-*/*/*.bbappend \
"

BBFILE_COLLECTIONS += "meta-rpi-podman"
BBFILE_PATTERN_meta-rpi-podman = "^${LAYERDIR}/"
BBFILE_PRIORITY_meta-rpi-podman = "12"

LAYERSERIES_COMPAT_meta-rpi-podman = "gatesgarth"
```
